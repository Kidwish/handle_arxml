AUTOSAR XML (schema 00049)
package /ComponentTypes
  swc implementation MySwc_Implementation: behavior=MySwc_InternalBehavior
